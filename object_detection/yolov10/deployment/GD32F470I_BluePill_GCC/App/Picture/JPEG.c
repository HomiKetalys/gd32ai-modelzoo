/*********************************************************************************************************
* 模块名称：JPEG.c
* 摘    要：JPEG显示模块
* 当前版本：1.0.0
* 作    者：Leyutek(COPYRIGHT 2018 - 2021 Leyutek. All rights reserved.)
* 完成日期：2021年07月01日
* 内    容：
* 注    意：                                                                  
**********************************************************************************************************
* 取代版本：
* 作    者：
* 完成日期：
* 修改内容：
* 修改文件：
*********************************************************************************************************/

/*********************************************************************************************************
*                                              包含头文件
*********************************************************************************************************/
#include "JPEG.h"
#include "tjpgd.h"
#include "JPEGImage.h"
#include "TLILCD.h"
#include "stdio.h"
#include "gd32f470x_conf.h"

/*********************************************************************************************************
*                                              宏定义
*********************************************************************************************************/
#define JPEG_BUF_SIZE 4096

/*********************************************************************************************************
*                                              枚举结构体
*********************************************************************************************************/

/*********************************************************************************************************
*                                              内部变量
*********************************************************************************************************/
//定义jpeg解码工作区大小(最少需要3092字节)，作为解压缓冲区，必须4字节对齐
__align(4) unsigned char s_arrJpegWorkBuf[JPEG_BUF_SIZE];


/*********************************************************************************************************
*                                              内部函数声明
*********************************************************************************************************/
static u32 JpegInfunc(JDEC* jd, u8* buf, u32 num);           //jpeg数据输入回调函数
static u32 JpegOutfunc(JDEC* jd, void* rgbbuf, JRECT* rect); //jpeg数据输出回调函数

/*********************************************************************************************************
*                                              内部函数实现
*********************************************************************************************************/
/*********************************************************************************************************
* 函数名称：JpegInfunc
* 函数功能：jpeg数据输入回调函数
* 输入参数：jd:储存待解码的对象信息的结构体
*          buf:输入数据缓冲区 (NULL:执行地址偏移)
*          num:需要从输入数据流读出的数据量/地址偏移量
* 输出参数：void
* 返 回 值：读取到的字节数/地址偏移量
* 创建日期：2021年07月01日
* 注    意：
*********************************************************************************************************/
static u32 JpegInfunc(JDEC* jd, u8* buf, u32 num) 
{
  u32 rb;                  //读取到的字节数
  StructJpegImage* device; //JPEG读取控制结构体
  u32 i;                   //循环变量

  device = (StructJpegImage*)jd->device;

  //buf非空表示TJpgDec模块要读取图片数据
  if(NULL != buf)
  {
    rb = 0;
    for(i = 0; i < num; i++)
    {
      if(device->readCnt < device->size)
      {
        buf[i] = device->image[device->readCnt];
        device->readCnt++;
        rb++;
      }
      else
      {
        break;
      }
    }
  }

  //buf为空表示TJpgDec模块要调整读取位置
  else
  {
    if((device->readCnt + num) < device->size)
    {
      device->readCnt = device->readCnt + num;
      rb = num;
    }
    else
    {
      rb = 0;
    }
  }

  return rb;
}

/*********************************************************************************************************
* 函数名称：JpegOutfunc
* 函数功能：jpeg数据输出回调函数
* 输入参数：jd:储存待解码的对象信息的结构体
*          rgbbuf:指向等待输出的RGB位图数据的指针
*          rect:等待输出的矩形图像的参数
* 输出参数：void
* 返 回 值：0,输出成功;1,输出失败/结束输出
* 创建日期：2021年07月01日
* 注    意：
*********************************************************************************************************/
static u32 JpegOutfunc(JDEC* jd, void* rgbbuf, JRECT* rect) 
{ 
  StructJpegImage* device;         //JPEG读取控制结构体
  u16*             pencolor;       //图像数据首地址
  u16              x0, y0, x1, y1; //起点、终点坐标

  //获取读取控制结构体
  device = (StructJpegImage*)jd->device;

  //计算起点、终点
  x0 = rect->left  + device->x0;
  y0 = rect->top   + device->y0;
  x1 = rect->right + device->x0;
  y1 = rect->bottom + device->y0;

  //根据缓冲区中的数据填充LCD
  pencolor = rgbbuf;
  LCDColorFillPixel(x0, y0, x1, y1, pencolor);

  //返回0使得模块继续工作
  return 0;
}

/*********************************************************************************************************
*                                              API函数实现
*********************************************************************************************************/
/*********************************************************************************************************
* 函数名称：InitJPEG
* 函数功能：初始化JPEG模块
* 输入参数：void
* 输出参数：void
* 返 回 值：void
* 创建日期：2021年07月01日
* 注    意：
*********************************************************************************************************/
void InitJPEG(void)
{

}

/*********************************************************************************************************
* 函数名称：DisplayJPEGInFlash
* 函数功能：绘制Flash中的JPEG图片
* 输入参数：image：图片控制结构体，x0、y0：绘制起点
* 输出参数：void
* 返 回 值：void
* 创建日期：2021年07月01日
* 注    意：
*********************************************************************************************************/
void DisplayJPEGInFlash(StructJpegImage* image, unsigned int x0, unsigned int y0)
{
  JDEC jpegDev;  //JPEG解码设备结构体

  //结构体信息不全
  if((NULL == image->image) || (0 == image->size))
  {
    printf("DisplayJPEGInFlash: you need to initialize image structure first\r\n");
    return;
  }

  image->x0 = x0;
  image->y0 = y0;
  image->readCnt = 0;

  //解码并显示
  if(JDR_OK == jd_prepare(&jpegDev, JpegInfunc, s_arrJpegWorkBuf, JPEG_BUF_SIZE, image))
  {
    jd_decomp(&jpegDev, JpegOutfunc, 0);
  }
}
/*********************************************************************************************************
* 函数名称：DisPlayBackgroudJPEG
* 函数功能：绘制背景图片
* 输入参数：void
* 输出参数：void
* 返 回 值：void
* 创建日期：2021年07月01日
* 注    意：
*********************************************************************************************************/
void DisPlayBackgroudJPEG(void)
{
  //背景图片控制结构体
  StructJpegImage backgroundImage;
  
  //初始化backgroundImage
  backgroundImage.image = (unsigned char*)s_arrJpegBackgroundImage;
  backgroundImage.size  = sizeof(s_arrJpegBackgroundImage) / sizeof(unsigned char);

  //解码并显示图片
  DisplayJPEGInFlash(&backgroundImage, 0, 0);
}


