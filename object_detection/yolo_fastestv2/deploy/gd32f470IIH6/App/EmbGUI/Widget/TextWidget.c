/*********************************************************************************************************
* 模块名称：TextWidget.c
* 摘    要：Text控件模块
* 当前版本：1.0.0
* 作    者：Leyutek(COPYRIGHT 2018 - 2021 Leyutek. All rights reserved.)
* 完成日期：2021年07月01日
* 内    容：
* 注    意：                                                                  
**********************************************************************************************************
* 取代版本：
* 作    者：
* 完成日期：
* 修改内容：
* 修改文件：
*********************************************************************************************************/

/*********************************************************************************************************
*                                              包含头文件
*********************************************************************************************************/
#include "TextWidget.h"
#include "gd32f450x_conf.h"
#include "TLILCD.h"
#include "stdio.h"

/*********************************************************************************************************
*                                              宏定义
*********************************************************************************************************/

/*********************************************************************************************************
*                                              枚举结构体定义
*********************************************************************************************************/

/*********************************************************************************************************
*                                              内部变量
*********************************************************************************************************/

/*********************************************************************************************************
*                                              内部函数声明
*********************************************************************************************************/
static void SetText(void* dev, const char* string); //设置显示内容

/*********************************************************************************************************
*                                              内部函数实现
*********************************************************************************************************/
/*********************************************************************************************************
* 函数名称：SetText
* 函数功能：设置显示内容
* 输入参数：dev：控件结构体地址，string：显示内容
* 输出参数：void
* 返 回 值：0-成功创建，其它-创建失败
* 创建日期：2021年07月01日
* 注    意：
*********************************************************************************************************/
static void SetText(void* dev, const char* string)
{
  u16* color;
  u16 x0, y0, x1, y1;
  StructTextWidget* text;
  u16 x, y, i;

  text = (StructTextWidget*)dev;
  x0 = text->x0;
  y0 = text->y0;
  x1 = x0 + text->width;
  y1 = y0 + text->height;
  color = text->background;
  LCDColorFillPixel(x0, y0, x1 - 1, y1 - 1, color);

  //判断是不是非法字符!
  i = 0;
  x = x0;
  y = y0;
  while((*(string + i) <= '~') && (*(string + i) >= ' '))
  {
    if(x > x1)
    {
      x = x0;
      y = y + text->size;
    }

    if(y > (y1 - text->size))
    {
      break;
    }
    
    LCDShowChar(x, y, LCD_FONT_24, LCD_TEXT_TRANS, text->color, NULL, *(string + i));

    x += text->size / 2;
    i++;
  }
}

/*********************************************************************************************************
*                                              API函数实现
*********************************************************************************************************/
/*********************************************************************************************************
* 函数名称：CreateTextWidget
* 函数功能：创建text控件
* 输入参数：void
* 输出参数：void
* 返 回 值：0-成功创建，其它-创建失败
* 创建日期：2021年07月01日
* 注    意：
*********************************************************************************************************/
u8 CreateTextWidget(StructTextWidget* text)
{
  u16 x, y, i;

  //未给定参数
  if((0 == text->width) || (0 == text->height))
  {
    return 1;
  }

  //字体大小系统不存在
  if(!(12 == text->size || 16 == text->size || 24 == text->size))
  {
    return 1;
  }

  //控件太大，背景缓冲区无法储存下所有的背景像素点
  if((text->width * text->height) > TEXT_WIDGET_BUF_SIZE)
  {
    return 1;
  }

  //将背景储存到缓冲区
  i = 0;
  for(y = text->y0; y < (text->y0 + text->height); y++)
  {
    for(x = text->x0; x < (text->x0 + text->width); x++)
    {
      text->background[i] = LCDReadPoint(x, y);
      i++;
    }
  }

  //设置setText函数指针内容，使得用户可以通过结构体成员setText修改显示内容
  text->setText = SetText;
  
  return 0;
}
