/*********************************************************************************************************
* 模块名称：GUIClock.c
* 摘    要：时钟模块
* 当前版本：1.0.0
* 作    者：Leyutek(COPYRIGHT 2018 - 2021 Leyutek. All rights reserved.)
* 完成日期：2021年07月01日
* 内    容：
* 注    意：
**********************************************************************************************************
* 取代版本：
* 作    者：
* 完成日期：
* 修改内容：
* 修改文件：
*********************************************************************************************************/

/*********************************************************************************************************
*                                              包含头文件
*********************************************************************************************************/
#include "GUIClock.h"
#include "GUIPlatform.h"
#include "TLILCD.h"
#include "BMP.h"
#include "Common.h"
#include "stdio.h"
#include "Malloc.h"
#include "FontLib.h"
#include "RTC.h"

/*********************************************************************************************************
*                                              宏定义
*********************************************************************************************************/
#define GUI_CLOCK_BACK_COLOR RGB888ToRGB565A(69, 185, 124) //时钟模块背景颜色

//时间显示位置定义
#define TIME_Y0  (160)
#define HOUR_X0  (120)
#define HOUR_X1  (HOUR_X0 + 80)
#define COLON_X0 (HOUR_X1 + 80)
#define MIN_X0   (COLON_X0 + 36)
#define MIN_X1   (MIN_X0 + 80)
#define COLON_X1 (MIN_X1 + 80)
#define SEC_X0   (COLON_X1 + 36)
#define SEC_X1   (SEC_X0 + 80)

/*********************************************************************************************************
*                                              枚举结构体定义
*********************************************************************************************************/

/*********************************************************************************************************
*                                              内部变量
*********************************************************************************************************/
//时间变量
static u32 s_iHour = 0xFFFFFFFF, s_iMin = 0xFFFFFFFF, s_iSec = 0xFFFFFFFF;

//星期字符串
static const char* s_arrWeek[] = 
{
  "星期一",
  "星期二",
  "星期三",
  "星期四",
  "星期五",
  "星期六",
  "星期天",
};

/*********************************************************************************************************
*                                              内部函数声明
*********************************************************************************************************/
static void DiaplayChar160x80(u32 x0, u32 y0, u32 code); //显示160x80字符

/*********************************************************************************************************
*                                              内部函数实现
*********************************************************************************************************/
/*********************************************************************************************************
* 函数名称：DiaplayChar160x80
* 函数功能：显示160x80字符
* 输入参数：x0、y0：显示起始坐标，code：ASCII码编码
* 输出参数：void
* 返 回 值：void
* 创建日期：2021年07月01日
* 注    意：
*          1、160x80汉字点阵数据固定为1600字节
*          2、扫描方式从左往右、从上到下，字节高位在前，低位在后
*********************************************************************************************************/
static void DiaplayChar160x80(u32 x0, u32 y0, u32 code)
{
  u32 x, y, i, j;
  u8 byte;
  u8* buf;

  //字符显示内存申请
  buf = MyMalloc(SRAMEX, 1600);
  if(NULL == buf)
  {
    printf("DiaplayChar160x80: 申请动态内存失败\r\n");
    while(1);
  }

  //获取点阵数据
  GetFont160x80(code, buf);

  //清背景
  if(':' == code)
  {
    LCDFill(x0, y0, 36, 160, GUI_CLOCK_BACK_COLOR);
  }
  else
  {
    LCDFill(x0, y0, 80, 160, GUI_CLOCK_BACK_COLOR);
  }

  //显示字符
  x = x0;
  y = y0;
  for(i = 0; i < 1600; i++)
  {
    byte = buf[i];
    for(j = 0; j < 8; j++)
    {
      if(byte & 0x80)
      {
        LCDDrawPoint(x, y, LCD_COLOR_WHITE);
      }
      byte = byte << 1;

      x++;
      if((x - x0) >= 80)
      {
        y++;
        x = x0;
      }
    }
  }

  //释放内存
  MyFree(SRAMEX, buf);
}

/*********************************************************************************************************
*                                              API函数实现
*********************************************************************************************************/
/*********************************************************************************************************
* 函数名称：CreateGUIClock
* 函数功能：创建时钟
* 输入参数：void
* 输出参数：void
* 返 回 值：void
* 创建日期：2021年07月01日
* 注    意：
*********************************************************************************************************/
void CreateGUIClock(void)
{
  //LCD横屏显示
  LCDDisplayDir(LCD_SCREEN_HORIZONTAL);

  //清空界面显示
  LCDClear(GUI_CLOCK_BACK_COLOR);
  
  //显示冒号
  DiaplayChar160x80(COLON_X0, TIME_Y0, ':');
  DiaplayChar160x80(COLON_X1, TIME_Y0, ':');

  s_iHour = 0xFFFFFFFF;
  s_iMin = 0xFFFFFFFF;
  s_iSec = 0xFFFFFFFF;
}

/*********************************************************************************************************
* 函数名称：DeleteGUIClock
* 函数功能：删除时钟
* 输入参数：void
* 输出参数：void
* 返 回 值：void
* 创建日期：2021年07月01日
* 注    意：
*********************************************************************************************************/
void DeleteGUIClock(void)
{

}

/*********************************************************************************************************
* 函数名称：GUIClockPoll
* 函数功能：时钟轮询任务
* 输入参数：void
* 输出参数：void
* 返 回 值：void
* 创建日期：2021年07月01日
* 注    意：
*********************************************************************************************************/
void GUIClockPoll(void)
{
  u32 hour, min, sec;
  u32 year, mon, date, week;
  char string[32];

  //获取时间
  RTCGetTime(&hour, &min, &sec);

  //小时高位
  if(((s_iHour / 10) != (hour / 10)) || (0xFFFFFFFF == s_iHour))
  {
    DiaplayChar160x80(HOUR_X0, TIME_Y0, 48 + hour / 10);
  }

  //小时低位
  if(((s_iHour % 10) != (hour % 10)) || (0xFFFFFFFF == s_iHour))
  {
    DiaplayChar160x80(HOUR_X1, TIME_Y0, 48 + hour % 10);
  }

  //分钟高位
  if(((s_iMin / 10) != (min / 10)) || (0xFFFFFFFF == s_iMin))
  {
    DiaplayChar160x80(MIN_X0, TIME_Y0, 48 + min / 10);
  }

  //分钟低位
  if(((s_iMin % 10) != (min % 10)) || (0xFFFFFFFF == s_iMin))
  {
    DiaplayChar160x80(MIN_X1, TIME_Y0, 48 + min % 10);
  }

  //秒高位
  if(((s_iSec / 10) != (sec / 10)) || (0xFFFFFFFF == s_iSec))
  {
    DiaplayChar160x80(SEC_X0, TIME_Y0, 48 + sec / 10);
  }

  //分钟低位
  if(((s_iSec % 10) != (sec % 10)) || (0xFFFFFFFF == s_iSec))
  {
    DiaplayChar160x80(SEC_X1, TIME_Y0, 48 + sec % 10);
  }

  //显示日期
  if((s_iHour != hour) || (s_iMin != min) || (s_iSec != sec))
  {
    RTCGetDate(&year, &mon, &date, &week);
    sprintf(string, "%02d年%02d月%02d日  %s", year, mon, date, s_arrWeek[week - 1]);
    LCDFill(0, TIME_Y0 - 10, 800, 24, GUI_CLOCK_BACK_COLOR);
    GUIDrawTextLine(HOUR_X0 + 10, TIME_Y0 - 10, (u32)string, GUI_FONT_ASCII_24, NULL, GUI_COLOR_WHITE, 1, 32);
  }

  s_iHour = hour;
  s_iMin = min;
  s_iSec = sec;
}
