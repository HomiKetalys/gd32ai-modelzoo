/*********************************************************************************************************
* 模块名称：SCCB.h
* 摘    要：SCCB协议驱动
* 当前版本：1.0.0
* 作    者：Leyutek(COPYRIGHT 2018 - 2021 Leyutek. All rights reserved.)
* 完成日期：2021年07月01日
* 内    容：
* 注    意：
**********************************************************************************************************
* 取代版本：
* 作    者：
* 完成日期：
* 修改内容：
* 修改文件：
*********************************************************************************************************/

/*********************************************************************************************************
*                                              包含头文件
*********************************************************************************************************/
#include "SCCB.h"
#include "gd32f470x_conf.h"
#include "SysTick.h"
#include "IICCommon.h"

/*********************************************************************************************************
*                                              宏定义
*********************************************************************************************************/

/*********************************************************************************************************
*                                              枚举结构体
*********************************************************************************************************/

/*********************************************************************************************************
*                                              内部变量
*********************************************************************************************************/
//IIC通信设备结构体
static StructIICCommonDev s_structIICDev;

/*********************************************************************************************************
*                                              内部函数声明
*********************************************************************************************************/
static void ConfigIICGPIO(void);    //配置IIC的GPIO
static void ConfigSDAMode(u8 mode); //配置SDA输入输出
static void SetSCL(u8 state);       //时钟信号线SCL控制
static void SetSDA(u8 state);       //数据信号线SDA控制
static u8   GetSDA(void);           //获取SDA输入电平
static void Delay(u8 time);         //延时函数

/*********************************************************************************************************
*                                              内部函数实现
*********************************************************************************************************/
/*********************************************************************************************************
* 函数名称：ConfigIICGPIO
* 函数功能：配置IIC的GPIO
* 输入参数：void 
* 输出参数：void
* 返 回 值：void
* 创建日期：2021年07月01日
* 注    意：
*********************************************************************************************************/
static void ConfigIICGPIO(void)
{
  //使能RCU相关时钟
  rcu_periph_clock_enable(RCU_GPIOB);  //使能GPIOB的时钟
  
  //SCL
  gpio_mode_set(GPIOB, GPIO_MODE_OUTPUT, GPIO_PUPD_PULLUP, GPIO_PIN_6);         //上拉输出
  gpio_output_options_set(GPIOB, GPIO_OTYPE_PP, GPIO_OSPEED_MAX,GPIO_PIN_6); //推挽输出
  gpio_bit_set(GPIOB, GPIO_PIN_6);                                              //拉高SCL
  
  //SDA
  gpio_mode_set(GPIOB, GPIO_MODE_OUTPUT, GPIO_PUPD_PULLUP, GPIO_PIN_7);         //上拉输出
  gpio_output_options_set(GPIOB, GPIO_OTYPE_PP, GPIO_OSPEED_MAX,GPIO_PIN_7); //推挽输出
  gpio_bit_set(GPIOB, GPIO_PIN_7);                                              //拉高SCL
}

/*********************************************************************************************************
* 函数名称：ConfigSDAMode
* 函数功能：配置SDA输入输出
* 输入参数：mode：IIC_COMMON_INPUT、IIC_COMMON_OUTPUT 
* 输出参数：void
* 返 回 值：void
* 创建日期：2018年01月01日
* 注    意：
*********************************************************************************************************/
static void ConfigSDAMode(u8 mode)
{
  rcu_periph_clock_enable(RCU_GPIOB);  //使能GPIOB的时钟

  //配置成输出
  if(IIC_COMMON_OUTPUT == mode)
  {
    gpio_mode_set(GPIOB, GPIO_MODE_OUTPUT, GPIO_PUPD_PULLUP, GPIO_PIN_7);         //上拉输出
    gpio_output_options_set(GPIOB, GPIO_OTYPE_PP, GPIO_OSPEED_MAX,GPIO_PIN_7); //推挽输出
  }
  
  //配置成输入
  else if(IIC_COMMON_INPUT == mode)
  {
    gpio_mode_set(GPIOB, GPIO_MODE_INPUT, GPIO_PUPD_PULLUP, GPIO_PIN_7);          //上拉输入
  }
}

/*********************************************************************************************************
* 函数名称：SetSCL
* 函数功能：时钟信号线SCL控制
* 输入参数：state：0-输入低电平，1-输出高电平
* 输出参数：void
* 返 回 值：void
* 创建日期：2018年01月01日
* 注    意：
*********************************************************************************************************/
static void SetSCL(u8 state)
{
  if(1 == state)
  {
    gpio_bit_set(GPIOB, GPIO_PIN_6);
  }
  else
  {
    gpio_bit_reset(GPIOB, GPIO_PIN_6);
  }
}

/*********************************************************************************************************
* 函数名称：SetSDA
* 函数功能：数据信号线SDA控制
* 输入参数：state：0-输入低电平，1-输出高电平
* 输出参数：void
* 返 回 值：void
* 创建日期：2018年01月01日
* 注    意：
*********************************************************************************************************/
static void SetSDA(u8 state)
{
  if(1 == state)
  {
    gpio_bit_set(GPIOB, GPIO_PIN_7);
  }
  else
  {
    gpio_bit_reset(GPIOB, GPIO_PIN_7);
  }
}

/*********************************************************************************************************
* 函数名称：GetSDA
* 函数功能：获取SDA输入电平
* 输入参数：void 
* 输出参数：void
* 返 回 值：SDA输入电平
* 创建日期：2018年01月01日
* 注    意：
*********************************************************************************************************/
static u8 GetSDA(void)
{
  if(RESET == gpio_input_bit_get(GPIOB, GPIO_PIN_7))
  {
    return 0;
  }
  else
  {
    return 1;
  }
}

/*********************************************************************************************************
* 函数名称：Delay
* 函数功能：延时函数
* 输入参数：time：延时时钟周期
* 输出参数：void
* 返 回 值：SDA输入电平
* 创建日期：2018年01月01日
* 注    意：
*********************************************************************************************************/
static void Delay(u8 time)
{
  DelayNus(50 * time);
}

/*********************************************************************************************************
*                                              API函数实现
*********************************************************************************************************/
/*********************************************************************************************************
* 函数名称：InitSCCB
* 函数功能：初始化SCCB接口
* 输入参数：void
* 输出参数：void
* 返 回 值：void
* 创建日期：2021年07月01日
* 注    意：
*********************************************************************************************************/
void InitSCCB(void)
{
  //初始化IIC的GPIO
  ConfigIICGPIO();

  //配置IIC
  s_structIICDev.deviceID      = SCCB_ID;       //设备ID
  s_structIICDev.SetSCL        = SetSCL;        //设置SCL电平值
  s_structIICDev.SetSDA        = SetSDA;        //设置SDA电平值
  s_structIICDev.GetSDA        = GetSDA;        //获取SDA输入电平
  s_structIICDev.ConfigSDAMode = ConfigSDAMode; //配置SDA输入输出方向
  s_structIICDev.Delay         = Delay;         //延时函数
}

/*********************************************************************************************************
* 函数名称：SCCBWriteReg
* 函数功能：写寄存器
* 输入参数：reg：寄存器地址，data：要写入的数据
* 输出参数：void
* 返 回 值：0-成功，1-失败
* 创建日期：2021年07月01日
* 注    意：
*********************************************************************************************************/
u8 SCCBWriteReg(u8 reg, u8 data)
{
  return IICCommonWriteBytes(&s_structIICDev, reg, &data, 1);
}

/*********************************************************************************************************
* 函数名称：SCCBReadReg
* 函数功能：读寄存器
* 输入参数：reg：寄存器地址
* 输出参数：void
* 返 回 值：读到的寄存器值
* 创建日期：2021年07月01日
* 注    意：
*********************************************************************************************************/
u8 SCCBReadReg(u8 reg)
{
  u8 readData;
  IICCommonReadBytes(&s_structIICDev, reg, &readData, 1, IIC_COMMON_NACK);
  return readData;
}

