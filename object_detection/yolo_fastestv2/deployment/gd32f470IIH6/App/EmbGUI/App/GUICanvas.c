/*********************************************************************************************************
* 模块名称：GUICanvas.c
* 摘    要：画布模块
* 当前版本：1.0.0
* 作    者：Leyutek(COPYRIGHT 2018 - 2021 Leyutek. All rights reserved.)
* 完成日期：2021年07月01日
* 内    容：
* 注    意：
**********************************************************************************************************
* 取代版本：
* 作    者：
* 完成日期：
* 修改内容：
* 修改文件：
*********************************************************************************************************/

/*********************************************************************************************************
*                                              包含头文件
*********************************************************************************************************/
#include "GUICanvas.h"
#include "GUIPlatform.h"
#include "TLILCD.h"
#include "BMP.h"
#include "Common.h"
#include "stdio.h"
#include "Touch.h"
#include "SysTick.h"
#include "KeyOne.h"

/*********************************************************************************************************
*                                              宏定义
*********************************************************************************************************/

/*********************************************************************************************************
*                                              枚举结构体定义
*********************************************************************************************************/

/*********************************************************************************************************
*                                              内部变量
*********************************************************************************************************/
//线条颜色
static const u16 s_arrLineColor[5] = {LCD_COLOR_YELLOW, LCD_COLOR_GREEN, LCD_COLOR_BLUE, LCD_COLOR_CYAN, LCD_COLOR_RED};

//触摸屏扫描结果
static StructTouchDev* s_pTouchDev;

//标记线条是否已开始绘制
static u8 s_arrFirstFlag[5] = {1, 1, 1, 1, 1}; 

//上一个点的坐标
static StructTouchPoint s_arrLastPoints[5];

/*********************************************************************************************************
*                                              内部函数声明
*********************************************************************************************************/
static void ClearCanvas(void); //清画布

/*********************************************************************************************************
*                                              内部函数实现
*********************************************************************************************************/
/*********************************************************************************************************
* 函数名称：ClearCanvas
* 函数功能：清画布
* 输入参数：void
* 输出参数：void
* 返 回 值：void
* 创建日期：2021年07月01日
* 注    意：
*********************************************************************************************************/
static void ClearCanvas(void)
{
  u32 i;

  //等待用户手指离开屏幕
  WaitForTouchRelease();

  //清画布
  DisPlayBMPByIPA(0, 0, MAIN_WINDOWN_BACKGROUND_DIR);
  for(i = 0; i < sizeof(s_arrFirstFlag) / sizeof(u8); i++)
  {
    s_arrFirstFlag[i] = 1;
    s_arrLastPoints[i].x = 0xFFFF;
    s_arrLastPoints[i].y = 0xFFFF;
    s_arrLastPoints[i].size = 0;
  }
}

/*********************************************************************************************************
*                                              API函数实现
*********************************************************************************************************/
/*********************************************************************************************************
* 函数名称：CreateGUICanvas
* 函数功能：创建画布
* 输入参数：void
* 输出参数：void
* 返 回 值：void
* 创建日期：2021年07月01日
* 注    意：
*********************************************************************************************************/
void CreateGUICanvas(void)
{
  //LCD竖屏显示
  LCDDisplayDir(LCD_SCREEN_VERTICAL);

  //清画布
  ClearCanvas();

  //获取触摸屏扫描设备结构体地址
  s_pTouchDev = GetTouchDev();
}

/*********************************************************************************************************
* 函数名称：GUICanvasPoll
* 函数功能：画布轮询任务
* 输入参数：void
* 输出参数：void
* 返 回 值：void
* 创建日期：2021年07月01日
* 注    意：
*********************************************************************************************************/
void GUICanvasPoll(void)
{
  u8  i;
  u16 x0, y0, x1, y1, size, color;

  //KEY1扫描
  ScanKeyOne(KEY_NAME_KEY1, NULL, ClearCanvas);

  //循环绘制5根线
  for(i = 0; i < 5; i++)
  {
    //有检测到按下
    if(1 == s_pTouchDev->pointFlag[i])
    {
      //获得起点终点坐标、颜色和触点大小
      x0    = s_arrLastPoints[i].x;
      y0    = s_arrLastPoints[i].y;
      x1    = s_pTouchDev->point[i].x;
      y1    = s_pTouchDev->point[i].y;
      color = s_arrLineColor[i];
      size  = s_pTouchDev->point[i].size;

      //触点太大，需要缩小处理
      size = size / 5;
      if(0 == size)
      {
        size = 1;
      }
      else if(size > 15)
      {
        size = 15;
      }
      
      //线条第一个点用画点方式
      if(1 == s_arrFirstFlag[i])
      {
        //标记线条已经开始绘制
        s_arrFirstFlag[i] = 0;
        GUIDrawPoint(x1, y1, size / 2, color);
      }

      //后边的用画线方式
      else
      {
        GUIDrawLine(x0, y0, x1, y1, size, color, GUI_LINE_CIRCLE);
      }

      //保存当前位置，为画线做准备
      s_arrLastPoints[i].x = s_pTouchDev->point[i].x;
      s_arrLastPoints[i].y = s_pTouchDev->point[i].y;
    }
    else
    {
      //标记该线条未开始绘制
      s_arrFirstFlag[i] = 1;
    }
  }
}

/*********************************************************************************************************
* 函数名称：DeleteGUICanvas
* 函数功能：删除画布
* 输入参数：void
* 输出参数：void
* 返 回 值：void
* 创建日期：2021年07月01日
* 注    意：
*********************************************************************************************************/
void DeleteGUICanvas(void)
{

}
