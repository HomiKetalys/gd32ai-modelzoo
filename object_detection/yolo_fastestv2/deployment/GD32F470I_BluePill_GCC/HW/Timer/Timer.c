/*********************************************************************************************************
* 模块名称：Timer.c
* 摘    要：Timer模块
* 当前版本：1.0.0
* 作    者：Leyutek(COPYRIGHT 2018 - 2022 Leyutek. All rights reserved.)
* 完成日期：2022年01月01日  
* 内    容：
* 注    意：
**********************************************************************************************************
* 取代版本：
* 作    者：
* 完成日期：
* 修改内容：
* 修改文件：
*********************************************************************************************************/

/*********************************************************************************************************
*                                              包含头文件
*********************************************************************************************************/
#include "Timer.h"
#include "gd32f470x_conf.h"
#include "Beep.h"

/*********************************************************************************************************
*                                              宏定义
*********************************************************************************************************/

/*********************************************************************************************************
*                                              枚举结构体
*********************************************************************************************************/

/*********************************************************************************************************
*                                              内部变量定义
*********************************************************************************************************/
static unsigned char  s_i1msFlag = FALSE;     //将1ms标志位的值设置为FALSE
static unsigned char  s_i2msFlag  = FALSE;    //将2ms标志位的值设置为FALSE
static unsigned char  s_i1secFlag = FALSE;    //将1s标志位的值设置为FALSE
u32 s_iCnt1000  = 0; 
u8 time_start=1;

/*********************************************************************************************************
*                                              内部函数声明
*********************************************************************************************************/
static void ConfigTimer1(unsigned short arr, unsigned short psc); //配置TIMER1
static void ConfigTimer4(unsigned short arr, unsigned short psc); //配置TIMER4
static u64 s_iSysTime  = 0;        //系统运行时间（ms）

/*********************************************************************************************************
*                                              内部函数实现
*********************************************************************************************************/
/*********************************************************************************************************
* 函数名称：ConfigTimer1
* 函数功能：配置TIMER1 
* 输入参数：arr-自动重装值，psc-预分频器值
* 输出参数：void
* 返 回 值：void
* 创建日期：2022年01月01日
* 注    意：
*********************************************************************************************************/
static  void ConfigTimer1(unsigned short arr, unsigned short psc)
{
  timer_parameter_struct timer_initpara;                //timer_initpara用于存放定时器的参数

  //使能RCU相关时钟
  rcu_periph_clock_enable(RCU_TIMER1);                  //使能TIMER1的时钟

  timer_deinit(TIMER1);                                 //设置TIMER1参数恢复默认值
  timer_struct_para_init(&timer_initpara);              //初始化timer_initpara
 
  //配置TIMER1
  timer_initpara.prescaler         = psc;               //设置预分频器值
  timer_initpara.counterdirection  = TIMER_COUNTER_UP;  //设置向上计数模式
  timer_initpara.period            = arr;               //设置自动重装载值
  timer_initpara.clockdivision     = TIMER_CKDIV_DIV1;  //设置时钟分割
  timer_init(TIMER1, &timer_initpara);                  //根据参数初始化定时器

  timer_interrupt_enable(TIMER1, TIMER_INT_UP);         //使能定时器的更新中断
  nvic_irq_enable(TIMER1_IRQn, 1, 0);                   //配置NVIC 设置优先级

  timer_enable(TIMER1);  //使能定时器
}

/*********************************************************************************************************
* 函数名称：ConfigTimer4
* 函数功能：配置TIMER4 
* 输入参数：arr-自动重装值，psc-预分频器值
* 输出参数：void
* 返 回 值：void
* 创建日期：2022年01月01日
* 注    意：
*********************************************************************************************************/
static  void ConfigTimer4(unsigned short arr, unsigned short psc)
{
  timer_parameter_struct timer_initpara;                //timer_initpara用于存放定时器的参数

  //使能RCU相关时钟
  rcu_periph_clock_enable(RCU_TIMER4);                  //使能TIMER4的时钟

  timer_deinit(TIMER4);                                 //设置TIMER4参数恢复默认值
  timer_struct_para_init(&timer_initpara);              //初始化timer_initpara
 
  //配置TIMER4
  timer_initpara.prescaler         = psc;               //设置预分频器值
  timer_initpara.counterdirection  = TIMER_COUNTER_UP;  //设置向上计数模式
  timer_initpara.period            = arr;               //设置自动重装载值
  timer_initpara.clockdivision     = TIMER_CKDIV_DIV1;  //设置时钟分割
  timer_init(TIMER4, &timer_initpara);                  //根据参数初始化定时器

  timer_interrupt_enable(TIMER4, TIMER_INT_UP);         //使能定时器的更新中断
  nvic_irq_enable(TIMER4_IRQn, 1, 0);                   //配置NVIC设置优先级

  timer_enable(TIMER4);  //使能定时器
}

/*********************************************************************************************************
* 函数名称：TIMER1_IRQHandler
* 函数功能：TIMER1中断服务函数 
* 输入参数：void
* 输出参数：void
* 返 回 值：void
* 创建日期：2022年01月01日
* 注    意：每毫秒进入一次中断服务函数
*********************************************************************************************************/
void TIMER1_IRQHandler(void)  
{
  static  unsigned short s_iCnt2 = 0;                                //定义一个静态变量s_iCnt2作为2ms计数器

  if (timer_interrupt_flag_get(TIMER1, TIMER_INT_FLAG_UP) == SET)    //判断定时器更新中断是否发生
  {
    timer_interrupt_flag_clear(TIMER1, TIMER_INT_FLAG_UP);           //清除定时器更新中断标志 
  }

  s_i1msFlag = TRUE;    //将1ms标志位的值设置为TRUE 

  s_iCnt2++;              //2ms计数器的计数值加1
  
  if(s_iCnt2 >= 2)        //2ms计数器的计数值大于或等于2
  {
    s_iCnt2 = 0;          //重置2ms计数器的计数值为0
    s_i2msFlag = TRUE;    //将2ms标志位的值设置为TRUE 
  }
	
	//蜂鸣器倒计时
  BeepCalcDown(1);

  //系统运行时间加一
  s_iSysTime++;
}

/*********************************************************************************************************
* 函数名称：TIMER4_IRQHandler
* 函数功能：TIMER4中断服务函数 
* 输入参数：void
* 输出参数：void
* 返 回 值：void
* 创建日期：2022年01月01日
* 注    意：每毫秒进入一次中断服务函数
*********************************************************************************************************/
void TIMER4_IRQHandler(void)  
{

  if (timer_interrupt_flag_get(TIMER4, TIMER_INT_FLAG_UP) == SET)    //判断定时器更新中断是否发生
  {
    timer_interrupt_flag_clear(TIMER4, TIMER_INT_FLAG_UP);           //清除定时器更新中断标志 
  }
  
  s_iCnt1000+=time_start;           //1000ms计数器的计数值加1
}

/*********************************************************************************************************
*                                              API函数实现
*********************************************************************************************************/
/*********************************************************************************************************
* 函数名称：InitTimer
* 函数功能：初始化Timer模块 
* 输入参数：void
* 输出参数：void
* 返 回 值：void
* 创建日期：2022年01月01日
* 注    意：
*********************************************************************************************************/
void InitTimer(void)
{
  ConfigTimer1(999, 239);  //240MHz/(239+1)=1MHz，由0计数到999为1ms
  ConfigTimer4(999, 239);  //240MHz/(239+1)=1MHz，由0计数到999为1ms
}

/*********************************************************************************************************
* 函数名称：Get1msFlag
* 函数功能：获取1ms标志位的值
* 输入参数：void
* 输出参数：void
* 返 回 值：s_i1msFlag-1ms标志位的值
* 创建日期：2022年01月01日
* 注    意：
*********************************************************************************************************/
unsigned char  Get1msFlag(void)
{
  return(s_i1msFlag);     //返回1ms标志位的值
}

/*********************************************************************************************************
* 函数名称：Clr1msFlag
* 函数功能：清除1ms标志位  
* 输入参数：void
* 输出参数：void
* 返 回 值：void
* 创建日期：2022年01月01日
* 注    意：
*********************************************************************************************************/
void  Clr1msFlag(void)
{
  s_i1msFlag = FALSE;     //将1ms标志位的值设置为FALSE 
}

/*********************************************************************************************************
* 函数名称：Get2msFlag
* 函数功能：获取2ms标志位的值
* 输入参数：void
* 输出参数：void
* 返 回 值：s_i2msFlag-2ms标志位的值
* 创建日期：2022年01月01日
* 注    意：
*********************************************************************************************************/
unsigned char  Get2msFlag(void)
{
  return(s_i2msFlag);     //返回2ms标志位的值
}

/*********************************************************************************************************
* 函数名称：Clr2msFlag
* 函数功能：清除2ms标志位  
* 输入参数：void
* 输出参数：void
* 返 回 值：void
* 创建日期：2022年01月01日
* 注    意：
*********************************************************************************************************/
void  Clr2msFlag(void)
{
  s_i2msFlag = FALSE;     //将2ms标志位的值设置为FALSE 
}

/*********************************************************************************************************
* 函数名称：Get1SecFlag
* 函数功能：获取1s标志位的值  
* 输入参数：void
* 输出参数：void
* 返 回 值：s_i1secFlag-1s标志位的值
* 创建日期：2022年01月01日
* 注    意：
*********************************************************************************************************/
unsigned char  Get1SecFlag(void)
{
  return(s_i1secFlag);    //返回1s标志位的值
}

/*********************************************************************************************************
* 函数名称：Clr1SecFlag
* 函数功能：清除1s标志位  
* 输入参数：void
* 输出参数：void
* 返 回 值：void
* 创建日期：2022年01月01日
* 注    意：
*********************************************************************************************************/
void  Clr1SecFlag(void)
{
  s_i1secFlag = FALSE;    //将1s标志位的值设置为FALSE
}

/*********************************************************************************************************
* 函数名称：GetSysTime
* 函数功能：获取系统运行时间（ms）
* 输入参数：void
* 输出参数：void
* 返 回 值：系统运行时间（ms）
* 创建日期：2021年07月01日
* 注    意：
*********************************************************************************************************/
u64 GetSysTime(void)
{
  return s_iSysTime;
}
