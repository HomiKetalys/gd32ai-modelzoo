/*********************************************************************************************************
* 模块名称：LED.c
* 摘    要：LED模块
* 当前版本：1.0.0
* 作    者：SZLY(COPYRIGHT 2018 - 2020 SZLY. All rights reserved.)
* 完成日期：2020年01月01日
* 内    容：
* 注    意：
**********************************************************************************************************
* 取代版本：
* 作    者：
* 完成日期：
* 修改内容：
* 修改文件：
*********************************************************************************************************/

/*********************************************************************************************************
*                                              包含头文件
*********************************************************************************************************/
#include "LED.h"
#include "gd32f470x_conf.h"


/*********************************************************************************************************
*                                              宏定义
*********************************************************************************************************/

/*********************************************************************************************************
*                                              枚举结构体
*********************************************************************************************************/

/*********************************************************************************************************
*                                              内部变量定义
*********************************************************************************************************/

/*********************************************************************************************************
*                                              内部函数声明
*********************************************************************************************************/
static  void  ConfigLEDGPIO(void);  //配置LED的GPIO

/*********************************************************************************************************
*                                              内部函数实现
*********************************************************************************************************/
/*********************************************************************************************************
* 函数名称：ConfigLEDGPIO
* 函数功能：配置LED的GPIO 
* 输入参数：void 
* 输出参数：void
* 返 回 值：void
* 创建日期：2018年01月01日
* 注    意：
*********************************************************************************************************/
static  void  ConfigLEDGPIO(void)
{
  //使能RCC相关时钟
  rcu_periph_clock_enable(RCU_GPIOB);  //使能GPIOB的时钟
  rcu_periph_clock_enable(RCU_GPIOI);  //使能GPIOI的时钟

  //配置LED1
  gpio_mode_set(GPIOB, GPIO_MODE_OUTPUT, GPIO_PUPD_PULLUP, GPIO_PIN_5);         //上拉输出
  gpio_output_options_set(GPIOB, GPIO_OTYPE_PP, GPIO_OSPEED_50MHZ, GPIO_PIN_5); //推挽输出
  gpio_bit_set(GPIOB, GPIO_PIN_5);                                              //点亮LED1

  //配置LED2
  gpio_mode_set(GPIOI, GPIO_MODE_OUTPUT, GPIO_PUPD_PULLUP, GPIO_PIN_8);        //上拉输出
  gpio_output_options_set(GPIOI, GPIO_OTYPE_PP, GPIO_OSPEED_50MHZ, GPIO_PIN_8); //推挽输出
  gpio_bit_reset(GPIOI, GPIO_PIN_8);                                           //熄灭LED2
}

/*********************************************************************************************************
*                                              API函数实现
*********************************************************************************************************/
/*********************************************************************************************************
* 函数名称：InitLED
* 函数功能：初始化LED模块
* 输入参数：void
* 输出参数：void
* 返 回 值：void
* 创建日期：2018年01月01日
* 注    意：
*********************************************************************************************************/
void InitLED(void)
{
  ConfigLEDGPIO();  //配置LED的GPIO
}

/*********************************************************************************************************
* 函数名称：LEDFlicker
* 函数功能：LED闪烁函数
* 输入参数：cnt
* 输出参数：void
* 返 回 值：void
* 创建日期：2018年01月01日
* 注    意：LEDFlicker在Proc2msTask中调用，cnt为250时表示每500ms更改一次LED状态
*********************************************************************************************************/
void LEDFlicker(u32 cnt)
{
  static u32 s_iCnt;  //定义静态变量s_iCnt作为计数器
  static u32 s_iState = 0; //0-LED1点亮，1-LED2点亮
  
  s_iCnt++; //计数器的计数值加1
  if(s_iCnt >= cnt)   //计数器的计数值大于cnt
  {
    s_iCnt = 0;       //重置计数器的计数值为0

    //LED1点亮
    if(0 == s_iState)
    {
      s_iState = 1;
      gpio_bit_set(GPIOB, GPIO_PIN_5);
      gpio_bit_reset(GPIOI, GPIO_PIN_8);
    }

    //LED2点亮
    else
    {
      s_iState = 0;
      gpio_bit_reset(GPIOB, GPIO_PIN_5);
      gpio_bit_set(GPIOI, GPIO_PIN_8);
    }
  }
}

/*********************************************************************************************************
* 函数名称：LEDCtrl
* 函数功能：LED灯控制函数
* 输入参数：led1、led2:LED灯状态，0-熄灭，1-点亮
* 输出参数：void
* 返 回 值：void
* 创建日期：2018年01月01日
* 注    意：
*********************************************************************************************************/
void LEDCtrl(u8 led1, u8 led2)
{
	//LED1
	if(0 == led1)
	{
		gpio_bit_write(GPIOA, GPIO_PIN_8, RESET);
	}
	else
	{
		gpio_bit_write(GPIOA, GPIO_PIN_8, SET);
	}
	
	//LED2
	if(0 == led2)
	{
		gpio_bit_write(GPIOE, GPIO_PIN_6, RESET);
	}
	else
	{
		gpio_bit_write(GPIOE, GPIO_PIN_6, RESET);
	}
}

